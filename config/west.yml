## config/west.yml
```yaml
manifest:
  remotes:
    - name: zmkfirmware
      url-base: https://github.com/zmkfirmware
    - name: refil
      url-base: https://github.com/refil
    - name: KinesisCorporation
      url-base: https://github.com/kinesiscorporation
    # Additional modules containing boards/shields/custom code can be listed here as well
    # See https://docs.zephyrproject.org/3.2.0/develop/west/manifest.html#projects
  projects:
    - name: zmk
      remote: refil
      revision: mwave
      import: app/west.yml
    - name: MWave-zephyr-module
      remote: KinesisCorporation
      import: config/west.yml
      revision: main
    - name: zmk-settings-reset-bootloader-module
      remote: refil
      revision: main
  self:
    path: config
```
